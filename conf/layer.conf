## conf/layer.conf
```bitbake
# We have a conf and classes directory, add to BBPATH
BBPATH .= ":${LAYERDIR}"

# We have recipes-* directories, add to BBFILES
BBFILES += "${LAYERDIR}/recipes-*/*/*.bb ${LAYERDIR}/recipes-*/*/*.bbappend"

BBFILE_COLLECTIONS += "embedded-dev"
BBFILE_PATTERN_embedded-dev = "^${LAYERDIR}/"
BBFILE_PRIORITY_embedded-dev = "1"

# This should only be incremented on significant changes that will
# cause compatibility issues with other layers
LAYERVERSION_embedded-dev = "1"

LAYERDEPENDS_embedded-dev = "core"

LAYERSERIES_COMPAT_embedded-dev = "scarthgap"
```

## conf/machine/beagleyai.conf
```bitbake
#@TYPE: Machine
#@NAME: J722S EVM
#@DESCRIPTION: Machine configuration for the TI J722S EVM

require conf/machine/include/j722s.inc

PREFERRED_PROVIDER_virtual/kernel = "linux-stable"
PREFERRED_PROVIDER_virtual/bootloader = "u-boot-beagley-dev"
PREFERRED_PROVIDER_u-boot = "u-boot-beagley-dev"

KERNEL_DEVICETREE_PREFIX = " \
    ti/k3-j722s \
"

KERNEL_DEVICETREE = "ti/k3-am67a-beagley-ai.dtb"

UBOOT_MACHINE = "j722s_evm_a53_defconfig"

PACKAGECONFIG:append:pn-linux-stable = "debug"

EMB_DEV_DTB ?= "k3-am67a-beagley-ai.dtb"
EMB_DEV_DTB_ADDR ?= "0xb0000000"
EMB_DEV_KERNEL_ADDR ?= "0xb2000000"
```

## conf/machine/imx8ulp-evk-dev.conf
```bitbake
require conf/machine/include/imx8ulp-evk.inc

KERNEL_DEVICETREE_BASENAME = "imx8ulp-evk"
UBOOT_CONFIG_BASENAME = "imx8ulp_evk"
#PREFERRED_PROVIDER_virtual/kernel = "linux-stable"
KERNEL_DEVICETREE = "freescale/imx8ulp-evk.dtb"

MACHINE_FEATURES += "soc-reva1"
UPOWER_FIRMWARE_NAME = "upower_a1.bin"
IMX_DEFAULT_BSP = "nxp"
ACCEPT_FSL_EULA = "1"
```
